DCL 01 L_SOIS514S,
        05 L_SOI_DICT_PTR          POINTER,
        05 L_SOI_BMCT_PTR          POINTER,
        05 L_SOIY660               POINTER,
        05 L_SOIYORD               POINTER,
        05 L_ERRS_WRITTEN          FIXED BIN(31),
        05 L_AUDIT_RECS_OUT        FIXED BIN(31),
        05 L_ERROR_INDEX           FIXED BIN(15),
        05 L_MODE                  CHAR(1),  
        05 L_USERID                CHAR(08),
        05 L_JOBNAME               CHAR(08),
        05 L_514S_PROCESS          CHAR(01), 
        05 L_EDIT_UPDATE           CHAR(01),
        05 L_ORD_ADD_CHG           CHAR(01), 
        05 L_USER_COMMENT          CHAR(14),
        05 L_ERROR_PTR             POINTER,
        05 L_TRACE                 CHAR(1),
        05 L_514S_BYPASS_CASH      CHAR(01),
        05 L_514S_BYPASS_SHP_ROUTE CHAR(01),
        05 L_SOIYSITB              POINTER,
        05 L_REV_DATE              FIXED BIN(15),
        05 L_AUTH_ONLY             CHAR(01),
        05 L_PIE_TYPE              CHAR(01),
        05 L_COAT                  CHAR(01),
        05 L_CONNECTED             CHAR(01),
        05 L_SSID                  CHAR(04);
 DCL
   S514S_ERR_MSG      CHAR(60) BASED( L_SOIS514S.L_ERROR_PTR );